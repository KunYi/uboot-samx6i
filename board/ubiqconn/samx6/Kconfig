## board/ubiqconn/samx6/Kconfig
```kconfig
if TARGET_SAMX6I

config SYS_BOARD
	default "samx6"

config SYS_VENDOR
	default "ubiqconn"

config SYS_SOC
	default "mx6"

config SYS_CONFIG_NAME
	default "samx6"

endif
```

## configs/samx6i_defconfig
```kconfig
CONFIG_SYS_EXTRA_OPTIONS="IMX_CONFIG=board/ubiqconn/samx6/mx6q_4x_mt41j128.cfg,MX6Q,SYS_BOOT_SPINOR,ANDROID_SUPPORT"
CONFIG_ARM=y
CONFIG_TARGET_SAMX6I=y
CONFIG_DM=y
CONFIG_DM_THERMAL=y
```
